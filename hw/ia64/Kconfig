## hw/ia64/Kconfig
```kconfig
config VIBTANIUM
    bool
    default y
    depends on IA64
    select ACPI
    select E1000_PCI
    select IDE_PIIX
    select ISA_BUS
    select PCI
    select PCKBD
    select SERIAL_MM
    select USB_OHCI_PCI
    select USB_UHCI
    select VGA_ISA
```
